# Copyright (C) 2023 Advanced Micro Devices, Inc. All rights reserved.

&i2c_smb_2 {
	status = "okay";
	label = "I2C7";
	port_sel = <7>;

	sda-gpios = <&gpio_000_036 12 0>;
	scl-gpios = <&gpio_000_036 13 0>;
};
