## Kconfig
```kconfig
#Platform configuration options

# Copyright (C) 2023 Advanced Micro Devices, Inc. All rights reserved.




mainmenu "Embedded controller firmware application"

rsource "app/peripheral_management/Kconfig"
rsource "app/power_sequencing/Kconfig"
rsource "app/saf/Kconfig"
rsource "app/smchost/Kconfig"
rsource "app/kbchost/Kconfig"
rsource "app/thermal_management/Kconfig"
rsource "app/usbc/Kconfig"
rsource "app/udc/Kconfig"
rsource "app/acpi/Kconfig"
rsource "app/wireless_manageability/Kconfig"
rsource "app/sfh/Kconfig"
rsource "app/als/Kconfig"
rsource "app/s0stest/Kconfig"
rsource "app/fanctrl/Kconfig"
rsource "app/ec_debug/Kconfig"
rsource "app/Kconfig"

menu "EC optional features"

rsource "app/power_management/Kconfig"
rsource "app/battery_management/Kconfig"
rsource "boards/Kconfig"

endmenu

menu "EC logging control"

config EC_DEBUG_LOG
	bool "Embedded controller logs"
	depends on LOG
	default y
	help
	  Enable minimum log level for all modules.

config EC_LOG_LEVEL
	int "Embedded controller application log level"
	depends on LOG
	default 2 if EC_DEBUG_LOG
	default 0
	help
	  Set log level for EC FW app modules.

config BOARD_LOG_LEVEL
	int "Board initialization log level"
	depends on LOG
	default 2 if EC_DEBUG_LOG
	default 0
	help
	  Set log level for board initialization module.

endmenu

rsource "drivers/Kconfig"
rsource "misc/Kconfig"
rsource "shell/Kconfig"
source "Kconfig.zephyr"
```

## app/Kconfig
```kconfig
# EC cross-module build options

# Copyright (C) 2023 Advanced Micro Devices, Inc. All rights reserved.

config HOT_BAG_EN
	bool "Enable hot bag feature"
	default n
	help
	  Indicate if hot bag feature is enabled.
```

## app/acpi/Kconfig
```kconfig
#EC app acpi build options

# Copyright (C) 2023 Advanced Micro Devices, Inc. All rights reserved.
menu "ACPI"

config EC_ACPI
	bool "Enable ACPI"
	default y
	help
	  Indicate if EC supports ACPI.

config ACPI
	bool "Enable ACPI"
	default y
	help
	  Indicate if EC supports ACPI.
	  
config ACPI_DAC_PWR
	bool "Enable ACPI DAC Power"
	default y
	help
	  Indicate if EC supports ACPI DAC Power adjust.
	  

config ACPI_LOG_LEVEL
	int "ACPI log level"
	depends on EC_ACPI
	depends on LOG
	default 2 if EC_DEBUG_LOG
	default 0
	help
	  Set log level for ACPI module.

endmenu
```

## app/als/Kconfig
```kconfig
# EC ALS (Ambient Light Sensor) module build options

# Copyright (C) 2025 Advanced Micro Devices, Inc. All rights reserved.

config ALS
	bool "Enable ALS (Ambient Light Sensor) feature"
	default n
	help
	  Enable support for Ambient Light Sensor (OPT4048) with
	  ACPI integration for Windows adaptive brightness.

config ALS_LOG_LEVEL
	int "ALS log level"
	depends on ALS
	depends on LOG
	default 2 if EC_DEBUG_LOG
	default 0
	help
	  Set log level for ALS module.
```

## app/battery_management/Kconfig
```kconfig
#EC battery management build options

# Copyright (C) 2023 Advanced Micro Devices, Inc. All rights reserved.

menu "Battery management"

config BATTERY_MANAGEMENT
	bool "Enable battery management"
	help
	  Indicate if EC supports charge, battery management.

config BATTERY_MGMT_LOG_LEVEL
	int "Battery management log level"
	depends on BATTERY_MANAGEMENT
	depends on LOG
	default 2 if EC_DEBUG_LOG
	default 0
	help
	  Set log level for battery management module.

endmenu
```

## app/ec_debug/Kconfig
```kconfig
#EC debug build options

# Copyright (C) 2023 Advanced Micro Devices, Inc. All rights reserved.

menu "EC_DEBUG"

config ECDBGI_SUPPORT
	bool "Enable ec debug interface"
	default y
	help
	  Use acpi ec name space for debug. This debug interface can
	  be accessed by using command 80h/81h through port 662h/666h.

config ECDBGI_LOG_LEVEL
	int "EC debug interface log level"
	depends on ECDBGI_SUPPORT
	depends on LOG
	default 4 if EC_DEBUG_LOG
	default 0
	help
	  Set log level for ec debug interface

config ECDBGI_ESPI_SLAVE_CAPABILITIES
	bool "Display part of EC slave capabilities"
	depends on ECDBGI_SUPPORT
	default y
	help
	  Display some eSPI registers, like General Capabilities and
	  Configurations and mmio decode range.

config ECDBGI_ESPI_PC_BUS_MASTER_TEST
	bool "Peripheral channel bus master"
	depends on ECDBGI_SUPPORT
	default y
	help
	   It allows the target to generate bus mastering cycles on the
	   peripheral channel which means EC can read data from specific
	   memory offset.

config ECDBGI_ESPI_VW_INFORMATION
	bool "Virtual wires channel information"
	depends on ECDBGI_SUPPORT
	default y
	help
	   Collect virtual wires data of EC registers. Please check EC
	   specification for more details.

config ECDBGI_ESPI_OOB_TEST
	bool "OOB (Tunneled SMBus) message channel test"
	depends on ECDBGI_SUPPORT
	depends on ESPI_OOB_CHANNEL
	default y
	help
	   Quick test for OOB channel. Please check EC
	   specification for more details.

config ECDBGI_ESPI_FA_TEST
	bool "Flash access channel test"
	depends on ECDBGI_SUPPORT
	default y
	help
	   Quick test for flash access channel(MAFS). Please check EC
	   specification for more details.

endmenu
```

## app/fanctrl/Kconfig
```kconfig
#EC Fan control build options

# Copyright (C) 2023 Advanced Micro Devices, Inc. All rights reserved.

menu "Fan Control"

config FAN_RPM_CONTROL
	bool "Enable fan RPM control"
	default n
	help
	  Indicate if EC supports fan RPM control.

config FANCTRL_LOG_LEVEL
	int "Fan control log level"
	depends on FAN_RPM_CONTROL
	depends on LOG
	default 2 if EC_DEBUG_LOG
	default 0
	help
	  Set log level for fan control module.

endmenu
```

## app/peripheral_management/Kconfig
```kconfig
# Kconfig - Config options for EC FW peripheral management
#
# Copyright (C) 2023 Advanced Micro Devices, Inc. All rights reserved.
#

config PERIPHERAL_MANAGEMENT
	bool "Enable EC human interface"
	default y
	help
	  Enable EC support for button, switches, this includes:
	  1) Buttons: i.e power button
	  2) Switches: EC HW straps used to change EC behavior.

config PERIPHERAL_BTN_DEBOUNCE_TIME
	int "Switches/button debounce time"
	default 10
	depends on PERIPHERAL_MANAGEMENT
	help
	  Indicate time in milliseconds used to debounce buttons
	  and switches for user interaction.

config PERIPHERAL_AC_PRENT_DEBOUNCE_TIME
	int "AC adapter present debounce time"
	default 10
	depends on PERIPHERAL_MANAGEMENT
	help
	  Indicate time in milliseconds used to debounce AC adapter present.
	  
config PERIPHERAL_UART_DONGLE_DEBOUNCE_TIME
	int "Uart dongle present debounce time"
	default 100
	depends on PERIPHERAL_MANAGEMENT
	help
	  Indicate time in milliseconds used to debounce Uart dongle present.
	  
config PERIPHERAL_BAT_INT_DEBOUNCE_TIME
	int "Bat in debounce time"
	default 10
	depends on PERIPHERAL_MANAGEMENT
	help
	  Indicate time in milliseconds used to debounce Bat in.

config PERIPHERAL_CHG_OK_DEBOUNCE_TIME
	int "chg ok debounce time"
	default 50
	depends on PERIPHERAL_MANAGEMENT
	help
	  Indicate time in milliseconds used to debounce chg ok.
	  
config PERIPHERAL_DOCK_IN_DEBOUNCE_TIME
	int "dock in debounce time"
	default 100
	depends on PERIPHERAL_MANAGEMENT
	help
	  Indicate time in milliseconds used to debounce dock in.
	  
config PERIPHERAL_LID_DEBOUNCE_TIME
	int "lid close debounce time"
	default 100
	depends on PERIPHERAL_MANAGEMENT
	help
	  Indicate time in milliseconds used to debounce lid close.
	  
config PERIPHERAL_DBG_CARD_DEBOUNCE_TIME
	int "debug card present debounce time"
	default 100
	depends on PERIPHERAL_MANAGEMENT
	help
	  Indicate time in milliseconds used to debounce debug card present.
	  
config PERIPHERAL_PD_SRC_ON_DEBOUNCE_TIME
	int "PD source on debounce time"
	default 100
	depends on PERIPHERAL_MANAGEMENT
	help
	  Indicate time in milliseconds used to debounce PD source on.
	  
config PERIPHERAL_UART0_INT_DEBOUNCE_TIME
	int "UART0 int on debounce time"
	default 3
	depends on PERIPHERAL_MANAGEMENT
	help
	  Indicate time in milliseconds used to debounce uart0 int.

config PERIPHERAL_SMI_INT_DEBOUNCE_TIME
	int "SMI int on debounce time"
	default 3
	depends on PERIPHERAL_MANAGEMENT
	help
	  Indicate time in milliseconds used to debounce smi int.

config PERIPHERAL_DISP_SW_DEBOUNCE_TIME
	int "display switch on debounce time"
	default 3
	depends on PERIPHERAL_MANAGEMENT
	help
	  Indicate time in milliseconds used to debounce display switch.

config PERIPHERAL_AC_330W_PRSNT_DEBOUNCE_TIME
	int "ac 330w present on debounce time"
	default 5
	depends on PERIPHERAL_MANAGEMENT
	help
	  Indicate time in milliseconds used to debounce ac 330w present.

config PERIPHERAL_CHG_PROCHOT1_DEBOUNCE_TIME
	int "charger prochot1 on debounce time"
	default 5
	depends on PERIPHERAL_MANAGEMENT
	help
	  Indicate time in milliseconds used to debounce charger prochot1.

config PERIPHERAL_CHG_PROCHOT2_DEBOUNCE_TIME
	int "charger prochot2 on debounce time"
	default 5
	depends on PERIPHERAL_MANAGEMENT
	help
	  Indicate time in milliseconds used to debounce charger prochot2.

config PERIPHERAL_MEM_PMIC_PG_DEBOUNCE_TIME
	int "mem pmic power good debounce time"
	default 5
	depends on PERIPHERAL_MANAGEMENT
	help
	  Indicate time in milliseconds used to debounce mem pmic power good.

config PERIPHERAL_LOG_LEVEL
	int "Peripheral log level"
	depends on PERIPHERAL_MANAGEMENT
	depends on LOG
	default 2 if EC_DEBUG_LOG
	default 0
	help
	  Set log level for peripheral module.
```

## app/power_management/Kconfig
```kconfig
# EC Power management build options

# Copyright (C) 2023 Advanced Micro Devices, Inc. All rights reserved.

menu "Power management"

config ACDCSWITCH
	bool "Enable AC DC switch"
	default y
	help
	  Simulate the DC and AC/DC switch mode for the user who don't have real battery.

config SLEEP
	bool "Enable sleep feature"
	default y
	help
	  Indicate if EC supports sleep in S3/S4/G3 when plug in ac.

config PSL
	bool "Enable PSL"
	depends on SLEEP
	default n
	help
	  Indicate if PSL is enabled.

config SLEEP_LOG_LEVEL
	int "sleep feature log level"
	depends on SLEEP
	depends on LOG
	default 2 if EC_DEBUG_LOG
	default 0
	help
	  Set log level for sleep feature.

config PWRMGMT
	bool "Enable EC power management"
	default y
	help
	  Indicate if EC supports power management this includes:
	  1) ACPI spec system transitions to S3, S4, S5
	  2) Intel-specific transitions to Sx sub-states during S3/S4/S5
	  (deep Sx) and or transition to S0ix during S0 (deep sleep)

config PWRMGMT_DEEPSX
	bool "Enable system deep suspend support"
	help
	  Indicate if EC supports deep suspend process. Deep suspend refers
	  to additional transition during S4, S5 states but reducing power
	  further since EC loses either context or power.

config PWRMGMT_DEEPSX_LOG_LEVEL
	int "Power management deep sx log level"
	depends on PWRMGMT
	depends on LOG
	default 2 if EC_DEBUG_LOG
	default 0
	help
	  Set log level for power management module which includes Intel
	  transitions into deep sx sub-states.

endmenu
```

## app/power_sequencing/Kconfig
```kconfig
# EC Power sequencing build options

# Copyright (C) 2023 Advanced Micro Devices, Inc. All rights reserved.

menu "Power on/bring-up overrides"

config EC_DELAYED_BOOT
	int "Enable EC FW delayed boot"
	default 0
	help
	  Indicate if EC FW boot is delayed for N seconds. This is useful to
	  debug early app initialization via serial logs or JTAG.

config PWRMGT_LOG_LEVEL
	int "Power management log level"
	depends on PWRMGMT
	depends on LOG
	default 3 if EC_DEBUG_LOG
	default 0
	help
	  Set log level for power management module.
endmenu
```

## app/s0stest/Kconfig
```kconfig
# EC S0S test build options

# Copyright (C) 2023 Advanced Micro Devices, Inc. All rights reserved.
menu "S0S_TEST"

config S0S_TEST
	bool "Enable S0S Testing"
	default y
	help
	  Indicate if EC supports S0S testing

config S0S_TEST_LOG_LEVEL
	int "S0S Test log level"
	depends on S0S_TEST
	depends on LOG
	default 4 if EC_DEBUG_LOG
	default 0
	help
	  Set log level for S0S test module.

endmenu
```

## app/sfh/Kconfig
```kconfig
# EC SFH module build options

# Copyright (C) 2023 Advanced Micro Devices, Inc. All rights reserved.

config SFH
	bool "Enable sfh feature"
	default n
	help
	  Indicate if udc management sfh is enabled.

config SFH_LOG_LEVEL
	int "sfh log level"
	depends on SFH
	depends on LOG
	default 2 if EC_DEBUG_LOG
	default 0
	help
	  Set log level for sfh.

config SFH_WAIE_LOG_LEVEL
	int "sfh log level"
	depends on SFH
	depends on LOG
	default 2 if EC_DEBUG_LOG
	default 0
	help
	  Set log level for sfh.
```

## app/thermal_management/Kconfig
```kconfig
# EC application thermal build options

# Copyright (C) 2023 Advanced Micro Devices, Inc. All rights reserved.


menu "Thermal management"

config THERMAL_MANAGEMENT
	bool "Enable thermal management"
	help
	  Indicate if EC supports management of fan, reading thermal
	  sensors and cpu temperature.

config THERMAL_MGMT_LOG_LEVEL
	int "Thermal management log level"
	depends on APP_THERMAL
	depends on LOG
	default 2 if EC_DEBUG_LOG
	default 0
	help
	  Set log level for thermal management module.

config APP_THERMAL
        bool "Enable AMD thermal application"
	help
	  Indicate if EC supports management of fan, reading thermal
	  sensors and cpu temperature.
endmenu
```

## app/udc/Kconfig
```kconfig
# EC UDC management build options

# Copyright (C) 2023 Advanced Micro Devices, Inc. All rights reserved.

config UDC_MANAGEMENT
	bool "Enable udc management"
	default n
	help
	  Indicate if udc management is enabled.

config UDC_LOG_LEVEL
	int "Debug Port80 log level"
	depends on UDC_MANAGEMENT
	depends on LOG
	default 2 if EC_DEBUG_LOG
	default 0
	help
	  Set log level for udc management.

config ESPI_PERIPHERAL_DEBUG_PORT_80
	default y if UDC_MANAGEMENT
	default n

config POWER_MONITOR
	bool "ina219 current/power monitor"
	depends on UDC_MANAGEMENT
	default y
	help
	  ina219 current/power monitor.
	  
config UDC_UART
	bool "ina219 current/power monitor"
	depends on UDC_MANAGEMENT
	default y
	help
	  ina219 current/power monitor.
```
