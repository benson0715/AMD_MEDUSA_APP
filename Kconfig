## dts/bindings/poc/vnd,poc-adc-channels.yaml
```yaml
# SPDX-License-Identifier: Apache-2.0

description: Bison stub poc-adc-channels container.

compatible: "vnd,poc-adc-channels"

child-binding:
  description: One ADC channel entry referenced by mdl_adc_hub.
  properties:
    enum-name:
      type: string
      required: true
    channel:
      type: int
      default: 0
    vref-mv:
      type: int
      default: 3300
    adc-ctrl:
      type: phandle
    io-channels:
      type: phandle-array
    handler:
      type: string
```

## dts/bindings/poc/vnd,poc-gpio-ints.yaml
```yaml
# SPDX-License-Identifier: Apache-2.0

description: |
  Container for GPIO interrupt callbacks installed by application code.
  Each child node describes one (pin, trigger, handler) triple. The
  middle layer (middle/gpio/mdl_gpio_hub.c) walks all child nodes
  during gpio_interrupt_configure_all() and registers them via
  gpio_init_callback / gpio_add_callback / gpio_pin_interrupt_configure.

  Property name conventions match what mdl_gpio_hub.c::INT_CONFIG_ENTRY
  reads — do not rename without updating the C side.

compatible: "vnd,poc-gpio-ints"

child-binding:
  description: A single GPIO interrupt entry.

  properties:
    irq-pin:
      type: phandle
      required: true
      description: |
        Phandle to a poc-gpios child node (the pin that triggers this
        interrupt). The middle layer extracts the encoded pin_idx via
        GPIO_VAL_FROM_ARRAY(irq_pin, gpios).
    flags:
      type: int
      required: true
      description: |
        Standard Zephyr GPIO_INT_* flag (e.g. GPIO_INT_EDGE_BOTH,
        GPIO_INT_EDGE_TO_ACTIVE, GPIO_INT_LEVEL_LOW). Passed to
        gpio_pin_interrupt_configure() unchanged.
    handler:
      type: string
      required: true
      description: |
        Name of a C function with the signature
            void name(const struct device *port,
                      struct gpio_callback *cb,
                      gpio_port_pins_t pins);
        The middle layer DT_FOREACH_CHILD generates a forward
        declaration for this name, so the linker checks at build
        time that the function exists.
```

## dts/bindings/poc/vnd,poc-gpios.yaml
```yaml
# SPDX-License-Identifier: Apache-2.0
#
# Stub binding for the `poc_gpios` parent node consumed by
# middle/gpio/mdl_gpio_hub.c. Each child supplies the gpios
# property + an enum-name string the C side turns into an
# `enum gpio_idx` member.

description: |
  Bison stub poc-gpios container. Children are individual GPIO
  pin objects consumed by mdl_gpio_hub.

compatible: "vnd,poc-gpios"

child-binding:
  description: A single GPIO pin entry referenced by the application.

  properties:
    gpios:
      type: phandle-array
      required: true
    enum-name:
      type: string
      required: true
    undefined-pin:
      type: int
      default: 0
    gpios_IDX_0_VAL_flags:
      type: int
      default: 0
```

## misc/Kconfig
```kconfig
#;*****************************************************************************
#; * Copyright (C) 2023 Advanced Micro Devices, Inc. All rights reserved.
#; ******************************************************************************
#; */



config NVOPTIONS_LOG_LEVEL
	int "Nvram log level feature"
	depends on LOG
	default 2 if EC_DEBUG_LOG
	default 0
	help
	  Set log level for Nvram feature.
config BRAM_LOG_LEVEL
	int "BRAM level feature"
	depends on LOG
	default 3 if EC_DEBUG_LOG
	default 0
	help
	  Set log level for BRAM feature.
config ROMSIG_LOG_LEVEL
	int "Rom sign level feature"
	depends on LOG
	default 3 if EC_DEBUG_LOG
	default 0
	help
	  Set log level for Rom Sign feature.
```

## out_of_tree_boards/boards/arm/npcx4mnx_boot/Kconfig.board
```kconfig
# Copyright (C) 2023 Advanced Micro Devices, Inc. All rights reserved.

config BOARD_npcx4mnx_boot
	bool "Nuvoton NPCX4M8F BOOT Development board"
	depends on SOC_NPCX4M8F
```

## out_of_tree_boards/boards/arm/npcx4mnx_boot/Kconfig.defconfig
```kconfig
# Copyright (C) 2023 Advanced Micro Devices, Inc. All rights reserved.

if BOARD_npcx4mnx_boot

config BOARD
	default "npcx4mnx_boot"

endif # BOARD_npcx4mnx_boot

config SYS_CLOCK_TICKS_PER_SEC
	default 1000

config INPUT
	bool "Input configuration option"
	default y if KSCAN
```

## out_of_tree_boards/boards/arm/npcx4mnx_boot/npcx4mnx_boot_defconfig
```kconfig
# Copyright (C) 2023 Advanced Micro Devices, Inc. All rights reserved.


CONFIG_SOC_NPCX4M8F=y
CONFIG_SOC_SERIES_NPCX4=y
CONFIG_BOARD_npcx4mnx_boot=y
CONFIG_FLASH_SIZE=64
# Enable NPCX firmware header
CONFIG_NPCX_HEADER=n
CONFIG_NPCX_IMAGE_OUTPUT_HEX=n
CONFIG_NPCX_HEADER_SPI_MAX_CLOCK_50=n
CONFIG_NPCX_HEADER_SPI_READ_MODE_DUAL=n
CONFIG_FLASH_SIZE=64
#mcu boot
CONFIG_FLASH_NPCX_FIU_NOR=y


# Enable MPU
CONFIG_ARM_MPU=y

# Clock configuration
CONFIG_CLOCK_CONTROL=y

# General Kernel Options
CONFIG_SYS_CLOCK_HW_CYCLES_PER_SEC=15000000

# UART Driver
CONFIG_SERIAL=y
CONFIG_UART_INTERRUPT_DRIVEN=y
CONFIG_UART_ASYNC_API=n
CONFIG_UART_NPCX_USE_MDMA=n

# GPIO Driver
CONFIG_GPIO=y

# Pin Controller Driver
CONFIG_PINCTRL=y

# Console Driver
CONFIG_CONSOLE=y
CONFIG_UART_CONSOLE=y

# SPI Flash
CONFIG_FLASH=y
CONFIG_FLASH_NPCX_FIU_QSPI=y
CONFIG_FLASH_JESD216_API=y
```
