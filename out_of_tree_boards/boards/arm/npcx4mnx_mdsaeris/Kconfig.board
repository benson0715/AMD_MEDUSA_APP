## out_of_tree_boards/boards/arm/npcx4mnx_mdsaeris/Kconfig.board
```kconfig
#;*****************************************************************************
#;
#; Copyright (C) 2023 Advanced Micro Devices, Inc. All rights reserved.
#;
#;******************************************************************************

config BOARD_NPCX4MNX_MDSAERIS
	bool "AMD NPCX4MNX Medusa FP10 AERIS CRB"
	depends on SOC_NPCX4M8F
```

## out_of_tree_boards/boards/arm/npcx4mnx_mdsdorne/Kconfig.board
```kconfig
#;*****************************************************************************
#;
#; Copyright (C) 2023 Advanced Micro Devices, Inc. All rights reserved.
#;
#;******************************************************************************

config BOARD_NPCX4MNX_MDSDORNE
	bool "AMD NPCX4MNX Medusa FP10 DORNE CRB"
	depends on SOC_NPCX4M8F
```

## out_of_tree_boards/boards/arm/npcx4mnx_mdsplum_ecmodule/Kconfig.board
```kconfig
#;*****************************************************************************
#;
#; Copyright (C) 2023 Advanced Micro Devices, Inc. All rights reserved.
#;
#;******************************************************************************


config BOARD_NPCX4MNX_MDSPLUM_ECMODULE
	bool "AMD NPCX4MNX Medusa FP10 Plum CRB EC MODULE"
	depends on SOC_NPCX4M8F
```

## out_of_tree_boards/boards/arm/npcx4mnx_mdsplum_ecmodule/npcx4mnx_mdsplum_ecmodule_defconfig
```kconfig
#;*****************************************************************************
#; * Copyright (C) 2023 Advanced Micro Devices, Inc. All rights reserved.
#; ******************************************************************************
#; */


CONFIG_SOC_NPCX4M8F=y
CONFIG_SOC_SERIES_NPCX4=y
CONFIG_BOARD_NPCX4MNX_MDSPLUM_ECMODULE=y
CONFIG_MAIN_STACK_SIZE=2048
CONFIG_RTOS_TIMER=y
CONFIG_CLOCK_CONTROL=y
CONFIG_GPIO=y
CONFIG_PINCTRL=y
CONFIG_SERIAL=y
CONFIG_CONSOLE=y
CONFIG_UART_CONSOLE=y
CONFIG_ADC=n
CONFIG_PWM=n
CONFIG_PWM_NPCX=n
CONFIG_SENSOR=y
CONFIG_I2C=y
CONFIG_I2C_INIT_PRIORITY=60
CONFIG_ESPI=y
CONFIG_BBRAM=y
CONFIG_BBRAM_NPCX=y
CONFIG_SPI=n
CONFIG_SPI_ASYNC=n
CONFIG_REBOOT=y
CONFIG_SMCHOST_EVENT_DRIVEN_TASK=y
CONFIG_LOG=y
CONFIG_FAN_RPM_CONTROL=n
CONFIG_ASSERT=n
CONFIG_FLASH_SIZE=288
CONFIG_ESPI_TAF_AUTO_MODE=y

CONFIG_LOG_PROCESS_THREAD_CUSTOM_PRIORITY=y
CONFIG_LOG_PROCESS_THREAD_PRIORITY=2

# Enable NPCX firmware header
CONFIG_NPCX_HEADER=n
CONFIG_NPCX_IMAGE_OUTPUT_HEX=y
CONFIG_NPCX_HEADER_SPI_MAX_CLOCK_50=n
CONFIG_NPCX_HEADER_SPI_READ_MODE_DUAL=n

# Clock configuration
CONFIG_CLOCK_CONTROL=y

# General Kernel Options
CONFIG_SYS_CLOCK_HW_CYCLES_PER_SEC=15000000

# UART Driver
CONFIG_SERIAL=y
CONFIG_UART_INTERRUPT_DRIVEN=y
CONFIG_UART_ASYNC_API=y
CONFIG_UART_NPCX_USE_MDMA=y

#SHELL
#---------------------
CONFIG_SHELL=n
CONFIG_SHELL_CMDS=n
CONFIG_SHELL_HISTORY=n
CONFIG_SHELL_BACKEND_SERIAL=n
CONFIG_REBOOT_SHELL=n
CONFIG_NVOPTION_SHELL=n
CONFIG_AMD_MEMORY_SHELL=n
CONFIG_AMD_GPIO_SHELL=n
CONFIG_AMD_SPIFLASH_SHELL=n

#EEPROM
#---------------------
CONFIG_AMD_EEPROM_SHELL=n

#SVI
#---------------------
CONFIG_VR_CONFIG_TABLE=y

#Power and battery management
#---------------------
CONFIG_BATTERY_MANAGEMENT=y
CONFIG_POWER_SOURCE_MANAGEMENT=y

#UDC management
#---------------------
CONFIG_UART_INTERRUPT_DRIVEN=y
CONFIG_UDC_MANAGEMENT=y
CONFIG_POWER_MONITOR=n
CONFIG_MODBUSRTU=n

#IO expander support
#---------------------
CONFIG_IO_EXPANDER=y

#EC KEYBOARD AND PS2 DEVICE
#---------------------
CONFIG_KSCAN=y
CONFIG_KSCAN_EC=y
CONFIG_EC_AMDCRB_KEYBOARD=y
CONFIG_GPIO_KSO_DRIVE=n
CONFIG_KSCAN_NPCX_KSO_HIGH_DRIVE=n
CONFIG_PS2=n
CONFIG_PS2_KEYBOARD=n
CONFIG_PS2_MOUSE=n

# EC FW features configuration
# ! Don't enable ESPI_PERIPHERAL_UART,
# ! UDC management will config this port.
# ----------------------------
CONFIG_ESPI_PERIPHERAL_UART=y
CONFIG_ESPI_PERIPHERAL_UART_SOC_MAPPING=0

#Code and Data Relocation
#---------------------
CONFIG_HAVE_CUSTOM_LINKER_SCRIPT=y
CONFIG_CUSTOM_LINKER_SCRIPT="linker_amdecver.ld"

#----------------------
# EC FW requires eSPI driver OOB Rx callback
CONFIG_ESPI_OOB_CHANNEL_RX_ASYNC=y
# Enable support for OOB Manager
CONFIG_OOBMNGR_SUPPORT=y
CONFIG_ECDBGI_SUPPORT=y
CONFIG_S0S_TEST=y
CONFIG_ECDBGI_ESPI_PC_BUS_MASTER_TEST=y
CONFIG_ECDBGI_ESPI_VW_INFORMATION=y
CONFIG_ECDBGI_ESPI_SLAVE_CAPABILITIES=y
CONFIG_ECDBGI_ESPI_FA_TEST=y
CONFIG_ECDBGI_ESPI_OOB_TEST=y
#----------------------
#SFH and I2C target device
#---------------------
CONFIG_I2C_TARGET=n
CONFIG_SFH=n

#Power save configuration
#---------------------
CONFIG_SLEEP=y
CONFIG_PSL=y

#eSPI SAF configuration
#---------------------
CONFIG_ESPI_SAF=n
CONFIG_ESPI_TAF_NPCX=y
CONFIG_ESPI_TAF_PR_NUM=16
CONFIG_ESPI_TAF_AUTO_MODE=y
CONFIG_SAF_ENABLE_XIP=n
CONFIG_SAF_SPI_WINBOND=n
CONFIG_SAF_SPI_GIGADEVICE=n

#Selectable DAC VALUE SUPPORT
#---------------------
CONFIG_SELECTABLE_DAC_VALUE=y

#SPI FLASH configuration
CONFIG_ESPI_FLASH_CHANNEL=y
CONFIG_FLASH_NPCX_FIU_SUPP_DRA_4B_ADDR=y
CONFIG_FLASH_EX_OP_ENABLED=y
CONFIG_FLASH_JESD216_API=y
CONFIG_FLASH=y
CONFIG_FLASH_NPCX_FIU_QSPI=y
CONFIG_ESPI_PERIPHERAL_ACPI_SHM_REGION=y
CONFIG_ESPI_PERIPHERAL_ACPI_SHM_REGION_PORT_NUM=0xFEC20200
CONFIG_NPCX_HEADER_SPI_MAX_CLOCK_50=y
CONFIG_NPCX_HEADER_CORE_CLOCK_SPI_CLOCK_RATIO_2=y
CONFIG_ESPI_PERIPHERAL_EC_HOST_CMD=y
CONFIG_ESPI_PERIPHERAL_HOST_CMD_DATA_PORT_NUM=0x668
CONFIG_ESPI_PERIPHERAL_ACPI_DATA_PORT_NUM=0x662
CONFIG_ESPI_NPCX_PERIPHERAL_SHAW3=y
CONFIG_ESPI_NPCX_PERIPHERAL_SHAW3_BASE=0x3F8
CONFIG_ESPI_NPCX_PERIPHERAL_SHAW3_IO=y
CONFIG_ESPI_NPCX_PERIPHERAL_SHAW3_SIZE=8

# AMD Thermal app
CONFIG_APP_THERMAL=y

#Kernel thread management support
# CONFIG_THREAD_MONITOR=y
CONFIG_THREAD_RUNTIME_STATS=y
# CONFIG_THREAD_RUNTIME_STATS_USE_TIMING_FUNCTIONS=n
# CONFIG_SCHED_THREAD_USAGE=y

#TIPD controller select
#---------------------
CONFIG_USBC_TIPD_TPS6699X=y
CONFIG_USBC_TIPD_TPS6599X=n

CONFIG_EC_MODULE=y
```

## out_of_tree_boards/boards/realtek/rts5918_mdsplum/Kconfig.defconfig
```kconfig
# SPDX-License-Identifier: Apache-2.0
#
# Copyright (c) 2026 Realtek Semiconductor Corporation
#

if BOARD_RTS5918_MDSPLUM

config BOARD
	default "rts5918_mdsplum"

if REALTEK_RTS5918_RTMR

config SYS_CLOCK_HW_CYCLES_PER_SEC
	default 32768

config SYS_CLOCK_TICKS_PER_SEC
	default 32768

endif # REALTEK_RTS5918_RTMR

config TICKLESS_KERNEL
	default y

endif # BOARD_RTS5918_MDSPLUM
```

## out_of_tree_boards/boards/realtek/rts5918_mdsplum/Kconfig.rts5918_mdsplum
```kconfig
# SPDX-License-Identifier: Apache-2.0
#
# Copyright (c) 2026 Realtek Semiconductor Corporation
#
# AMD MDS Plum hardware refreshed with the Realtek RTS5918 EC SoC in place
# of the original Nuvoton NPCX4MNx. The board carries forward Plum's I2C
# topology (4 buses) and sensor / VR / PD / IO-expander population; only
# the EC silicon and its pin-mux change.

config BOARD_RTS5918_MDSPLUM
	select SOC_RTS5918
	select CPU_HAS_FPU
	select HAS_PM
```

## shell/Kconfig
```kconfig
#;*****************************************************************************
#; * Copyright (C) 2023 Advanced Micro Devices, Inc. All rights reserved.
#; ******************************************************************************
#; */

config REBOOT_SHELL
	bool "Enable reboot shell"
	help
	  This shell provides access to reboot systerm

config AMD_EEPROM_SHELL
	bool "Enable eeprom shell"
	help
	  This shell provides eeprom access to systerm

config AMD_EEPROM_SHELL_BUFFER_SIZE
	int "EEPROM shell buffer size"
	default 256
	depends on AMD_EEPROM_SHELL
	help
	  Size of the buffer used for EEPROM read/write commands in
	  the EEPROM shell.
config NVOPTION_SHELL
	bool "Enable nv option shell"
	help
	  This shell provides nv option access to systerm
config AMD_MEMORY_SHELL
	bool "Enable memory shell"
	help
	  This shell provides memory access to systerm
config AMD_MEMORY_SHELL_BUFFER_SIZE
	int "Memory shell buffer size"
	default 256
	depends on AMD_MEMORY_SHELL
	help
	  Size of the buffer used for memory read/write commands in
	  the memory shell.
config AMD_GPIO_SHELL
	bool "Enable gpio test shell"
	help
	  This shell provides gpio test access to systerm
config AMD_SPIFLASH_SHELL
	bool "Enable spi flash read shell"
	help
	  This shell provides spi flash read access to systerm
```

## utilities/Kconfig
```kconfig
/*****************************************************************************
 * Copyright (C) 2023 Advanced Micro Devices, Inc. All rights reserved.
 ******************************************************************************
 */


config REBOOT_SHELL
	bool "Enable reboot shell"
	help
	  This shell provides access to reboot systerm

config AMD_EEPROM_SHELL
	bool "Enable eeprom shell"
	help
	  This shell provides eeprom access to systerm

config AMD_EEPROM_SHELL_BUFFER_SIZE
	int "EEPROM shell buffer size"
	default 256
	depends on AMD_EEPROM_SHELL
	help
	  Size of the buffer used for EEPROM read/write commands in
	  the EEPROM shell.
```

## west.yml
```yaml
manifest:

  remotes:
    - name: zephyrproject
      url-base: https://github.com/zephyrproject-rtos

  projects:
    - name: zephyr_public
      repo-path: zephyr.git
      path: zephyr_base/zephyr_fork
      remote: zephyrproject
      revision: v3.7.1
      clone-depth: 1
      west-commands: scripts/west-commands.yml

    - name: cmsis
      remote: zephyrproject
      revision: 4b96cbb174678dcd3ca86e11e1f24bc5f8726da0
      path: zephyr_base/modules/hal/cmsis

  self:
    path: zephyr_base
```

## zephyr_patches/west.yml
```yaml
manifest:

  remotes:
    - name: zephyrproject
      url-base: https://github.com/zephyrproject-rtos
    - name: zephyrproject_nuvoton
      url-base: https://github.com/Nuvoton-EC-FAE

  # The list of dependencies
  #
  projects:
    - name: zephyr
      path: ecfwwork/zephyr_fork
      remote: origin
      revision: npcx-v3.2-branch
      clone-depth: 1
      west-commands: scripts/west-commands.yml
      remote: zephyrproject_nuvoton

  self:
    path: ecfwwork
```
