/* Copyright 2025 Authors Titan.Chen
 * Use of this source code is governed by a BSD-style license that can be
 * found in the LICENSE file.
 */

/ {
	aliases {
		rtk-rtc = &rtc;
	};
};

&rtc {
	status = "okay";
};

