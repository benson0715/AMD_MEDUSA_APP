## CMakeLists.txt
```
# Copyright (C) 2023 Advanced Micro Devices, Inc. All rights reserved.

cmake_minimum_required(VERSION 3.20.0)
set(BOARD_ROOT ${CMAKE_CURRENT_LIST_DIR}/../out_of_tree_boards)
find_package(Zephyr REQUIRED HINTS $ENV{ZEPHYR_BASE})
project(ecfw)

target_sources(app PRIVATE src/main.c)
target_sources(app PRIVATE src/memory_service.c)
target_sources(app PRIVATE src/gpio_shell.c)
target_sources(app PRIVATE src/flash_shell.c)

zephyr_compile_options(-Werror)
zephyr_compile_options(-Wno-unused-variable)
```

## prj.conf
```kconfig
# CONFIG_SERIAL=y
# CONFIG_NATIVE_UART_0_ON_STDINOUT=y
# CONFIG_PRINTK=y
# CONFIG_UART_INTERRUPT_DRIVEN=y
CONFIG_SHELL=y
CONFIG_SHELL_CMDS=y
CONFIG_SHELL_HISTORY=y
CONFIG_SHELL_BACKEND_SERIAL=y
CONFIG_SHELL_PROMPT_UART="boot:~$ "
CONFIG_BOOT_BANNER=n
# CONFIG_LOG=y
```

## src/main.c
```c
/*****************************************************************************
 * Copyright (C) 2023 Advanced Micro Devices, Inc. All rights reserved.
 ******************************************************************************
 */

#include <zephyr/kernel.h>
#include <zephyr/shell/shell.h>
#include <version.h>

static const char *app_version = "1.0.0";

/**
 * @brief Shell command to display board information
 */
static int cmd_info_board(const struct shell *sh, size_t argc, char **argv)
{
	ARG_UNUSED(argc);
	ARG_UNUSED(argv);

	shell_print(sh, CONFIG_BOARD);

	return 0;
}

/**
 * @brief Shell command to display Zephyr kernel version
 */
static int cmd_info_version(const struct shell *sh, size_t argc, char **argv)
{
	ARG_UNUSED(argc);
	ARG_UNUSED(argv);

	shell_print(sh, "Zephyr version %s", KERNEL_VERSION_STRING);

	return 0;
}

/**
 * @brief Shell command to boot application from specified address
 */
static int cmd_boot_app(const struct shell *sh, size_t argc, char **argv)
{
	ARG_UNUSED(argc);
	ARG_UNUSED(argv);
	unsigned int address;
	unsigned int addr_p;
	void (*JMP_func_pointer)();
 	addr_p = 0x10070404;
	address = *(int*)addr_p;
	JMP_func_pointer=(void*)(address);
	irq_lock();
	JMP_func_pointer();

	return 0;
}

/**
 * @brief Shell command to display application version
 */
static int cmd_info_app_version(const struct shell *sh, size_t argc, char **argv)
{
	ARG_UNUSED(argc);
	ARG_UNUSED(argv);

	shell_print(sh, "App version %s", app_version);

	return 0;
}

/**
 * @brief Shell command to display help information
 */
static int cmd_shell_help(const struct shell *sh, size_t argc, char **argv)
{
	shell_print(sh, "show help: %d", argc);
    if(argc == 1){
        shell_help(sh);
        return SHELL_CMD_HELP_PRINTED;
    }

	for(size_t i=0; i< argc; i++){
		shell_print(sh, "check arg %d: %s", i, argv[i]);
	}

	return 0;
}

/**
 * @brief Main entry point for Zephyr bootloader
 */
void main(void)
{
	printk("*** Enter Zephyr Bootloader Version 0.1.0 ***\n");
	unsigned int address;
	unsigned int addr_p;
	void (*JMP_func_pointer)();
 	addr_p = 0x10070404;
	address = *(int*)addr_p;
	JMP_func_pointer=(void*)(address);
	irq_lock();
	JMP_func_pointer();
	while(1)
	{		
		k_msleep(2100);
	}
}

SHELL_STATIC_SUBCMD_SET_CREATE(subinfo,
    SHELL_CMD(board, NULL, "Show board command.", cmd_info_board),
    SHELL_CMD(version, NULL, "Show Zephyr version command.", cmd_info_version),
    SHELL_CMD(app_version, NULL, "Show app version command.", cmd_info_app_version),
    SHELL_CMD(app, NULL, "Show app command.", cmd_boot_app),
    SHELL_SUBCMD_SET_END
);

SHELL_CMD_REGISTER(boot, &subinfo, "Demo commands", cmd_shell_help);
```

## src/flash_shell.c
```c
/*****************************************************************************
 * Copyright (C) 2023 Advanced Micro Devices, Inc. All rights reserved.
 ******************************************************************************
 */

#include <zephyr/kernel.h>
#include <zephyr/devicetree.h>

#include <zephyr/shell/shell.h>
#include <zephyr/sys/util.h>

#include <stdlib.h>
#include <string.h>
#include <zephyr/drivers/flash.h>

/* Buffer is only needed for bytes that follow command and offset */
#define BUF_ARRAY_CNT (CONFIG_SHELL_ARGC_MAX - 2)
#define TEST_ARR_SIZE 0x1000

/* This only issues compilation error when it would not be possible
 * to extract at least one byte from command line arguments, yet
 * it does not warrant successful writes if BUF_ARRAY_CNT
 * is smaller than flash write alignment.
 */
BUILD_ASSERT(BUF_ARRAY_CNT >= 1);

static const struct device *const zephyr_flash_controller =
	DEVICE_DT_GET_OR_NULL(DT_CHOSEN(zephyr_flash_controller));

static uint8_t __aligned(4) test_arr[TEST_ARR_SIZE];

/**
 * @brief Parse flash command arguments to extract device and address
 *
 * @param shell Shell instance
 * @param argc Pointer to argument count
 * @param argv Pointer to argument vector
 * @param flash_dev Pointer to store flash device
 * @param addr Pointer to store address
 * @return 0 on success, negative error code on failure
 */
static int parse_helper(const struct shell *shell, size_t *argc,
		char **argv[], const struct device * *flash_dev,
		uint32_t *addr)
{
	char *endptr;

	*addr = strtoul((*argv)[1], &endptr, 16);

	if (*endptr != '\0') {
		/* flash controller from user input */
		*flash_dev = device_get_binding((*argv)[1]);
		if (!*flash_dev) {
			shell_error(shell, "Given flash device was not found");
			return -ENODEV;
		}
	} else if (zephyr_flash_controller != NULL) {
		/* default to zephyr,flash-controller */
		if (!device_is_ready(zephyr_flash_controller)) {
			shell_error(shell, "Default flash driver not ready");
			return -ENODEV;
		}
		*flash_dev = zephyr_flash_controller;
	} else {
		/* no flash controller given, no default available */
		shell_error(shell, "No flash device specified (required)");
		return -ENODEV;
	}

	if (*endptr == '\0') {
		return 0;
	}
	if (*argc < 3) {
		shell_error(shell, "Missing address.");
		return -EINVAL;
	}
	*addr = strtoul((*argv)[2], &endptr, 16);
	(*argc)--;
	(*argv)++;
	return 0;
}

/**
 * @brief Shell command handler for flash erase operation
 */
static int cmd_erase(const struct shell *shell, size_t argc, char *argv[])
{
	const struct device *flash_dev;
	uint32_t page_addr;
	int result;
	uint32_t size;

	result = parse_helper(shell, &argc, &argv, &flash_dev, &page_addr);
	if (result) {
		return result;
	}
	if (argc > 2) {
		size = strtoul(argv[2], NULL, 16);
	} else {
		struct flash_pages_info info;

		result = flash_get_page_info_by_offs(flash_dev, page_addr,
						     &info);

		if (result != 0) {
			shell_error(shell, "Could not determine page size, "
				    "code %d.", result);
			return -EINVAL;
		}

		size = info.size;
	}

	result = flash_erase(flash_dev, page_addr, size);

	if (result) {
		shell_error(shell, "Erase Failed, code %d.", result);
	} else {
		shell_print(shell, "Erase success.");
	}

	return result;
}

/**
 * @brief Shell command handler for flash write operation
 */
static int cmd_write(const struct shell *shell, size_t argc, char *argv[])
{
	uint32_t __aligned(4) check_array[BUF_ARRAY_CNT];
	uint32_t __aligned(4) buf_array[BUF_ARRAY_CNT];
	const struct device *flash_dev;
	uint32_t w_addr;
	int ret;
	size_t op_size;

	ret = parse_helper(shell, &argc, &argv, &flash_dev, &w_addr);
	if (ret) {
		return ret;
	}

	if (argc <= 2) {
		shell_error(shell, "Missing data to be written.");
		return -EINVAL;
	}

	op_size = 0;

	for (int i = 2; i < argc; i++) {
		int j = i - 2;

		buf_array[j] = strtoul(argv[i], NULL, 16);
		check_array[j] = ~buf_array[j];

		op_size += sizeof(buf_array[0]);
	}

	if (flash_write(flash_dev, w_addr, buf_array, op_size) != 0) {
		shell_error(shell, "Write internal ERROR!");
		return -EIO;
	}

	shell_print(shell, "Write OK.");

	if (flash_read(flash_dev, w_addr, check_array, op_size) < 0) {
		shell_print(shell, "Verification read ERROR!");
		return -EIO;
	}

	if (memcmp(buf_array, check_array, op_size) == 0) {
		shell_print(shell, "Verified.");
	} else {
		shell_error(shell, "Verification ERROR!");
		return -EIO;
	}

	return 0;
}

/**
 * @brief Shell command handler for flash read operation
 */
static int cmd_read(const struct shell *shell, size_t argc, char *argv[])
{
	const struct device *flash_dev;
	uint32_t addr;
	int todo;
	int upto;
	int cnt;
	int ret;

	ret = parse_helper(shell, &argc, &argv, &flash_dev, &addr);
	if (ret) {
		return ret;
	}

	if (argc > 2) {
		cnt = strtoul(argv[2], NULL, 16);
	} else {
		cnt = 1;
	}

	for (upto = 0; upto < cnt; upto += todo) {
		uint8_t data[SHELL_HEXDUMP_BYTES_IN_LINE];

		todo = MIN(cnt - upto, SHELL_HEXDUMP_BYTES_IN_LINE);
		ret = flash_read(flash_dev, addr, data, todo);
		if (ret != 0) {
			shell_error(shell, "Read ERROR!");
			return -EIO;
		}
		shell_hexdump_line(shell, addr, data, todo);
		addr += todo;
	}

	shell_print(shell, "");

	return 0;
}

/**
 * @brief Shell command handler for reading flash JEDEC ID
 */
static int cmd_read_id(const struct shell *shell, size_t argc, char *argv[])
{
	const struct device *flash_dev;
	int ret;
	uint32_t addr;
	uint8_t data[SHELL_HEXDUMP_BYTES_IN_LINE];
	ret = parse_helper(shell, &argc, &argv, &flash_dev, &addr);
	if (ret) {
		return ret;
	}


	ret = flash_read_jedec_id(flash_dev, data);
	if (ret != 0) {
		shell_error(shell, "Read ERROR!");
			return -EIO;
	}
	shell_print(shell, "id = %x %x %x",data[0],data[1],data[2]);

	shell_print(shell, "");

	return 0;
}

/**
 * @brief Shell command handler for reading flash SFDP data
 */
static int cmd_read_sfdp(const struct shell *shell, size_t argc, char *argv[])
{
	const struct device *flash_dev;
	uint32_t addr;
	int todo;
	int upto;
	int cnt;
	int ret;

	ret = parse_helper(shell, &argc, &argv, &flash_dev, &addr);
	if (ret) {
		return ret;
	}

	if (argc > 2) {
		cnt = strtoul(argv[2], NULL, 16);
	} else {
		cnt = 1;
	}

	for (upto = 0; upto < cnt; upto += todo) {
		uint8_t data[SHELL_HEXDUMP_BYTES_IN_LINE];

		todo = MIN(cnt - upto, SHELL_HEXDUMP_BYTES_IN_LINE);
		ret = flash_sfdp_read(flash_dev, addr, data, todo);
		if (ret != 0) {
			shell_error(shell, "Read ERROR!");
			return -EIO;
		}
		shell_hexdump_line(shell, addr, data, todo);
		addr += todo;
	}

	shell_print(shell, "");

	return 0;
}

/**
 * @brief Shell command handler for flash erase-write test
 */
static int cmd_test(const struct shell *shell, size_t argc, char *argv[])
{
	const struct device *flash_dev;
	uint32_t repeat;
	int result;
	uint32_t addr;
	uint32_t size;

	result = parse_helper(shell, &argc, &argv, &flash_dev, &addr);
	if (result) {
		return result;
	}

	size = strtoul(argv[2], NULL, 16);
	repeat = strtoul(argv[3], NULL, 16);
	if (size > TEST_ARR_SIZE) {
		shell_error(shell, "<size> must be at most 0x%x.",
			    TEST_ARR_SIZE);
		return -EINVAL;
	}

	for (uint32_t i = 0; i < size; i++) {
		test_arr[i] = (uint8_t)i;
	}

	result = 0;

	while (repeat--) {
		result = flash_erase(flash_dev, addr, size);

		if (result) {
			shell_error(shell, "Erase Failed, code %d.", result);
			break;
		}

		shell_print(shell, "Erase OK.");

		result = flash_write(flash_dev, addr, test_arr, size);

		if (result) {
			shell_error(shell, "Write internal ERROR!");
			break;
		}

		shell_print(shell, "Write OK.");
	}

	if (result == 0) {
		shell_print(shell, "Erase-Write test done.");
	}

	return result;
}

/**
 * @brief Dynamic shell command callback for device name completion
 */
static void device_name_get(size_t idx, struct shell_static_entry *entry);

SHELL_DYNAMIC_CMD_CREATE(dsub_device_name, device_name_get);

static void device_name_get(size_t idx, struct shell_static_entry *entry)
{
	const struct device *dev = shell_device_lookup(idx, NULL);

	entry->syntax = (dev != NULL) ? dev->name : NULL;
	entry->handler = NULL;
	entry->help  = NULL;
	entry->subcmd = &dsub_device_name;
}

SHELL_STATIC_SUBCMD_SET_CREATE(flash_cmds,
	SHELL_CMD_ARG(erase, &dsub_device_name,
		"[<device>] <page address> [<size>]",
		cmd_erase, 2, 2),
	SHELL_CMD_ARG(read, &dsub_device_name,
		"[<device>] <address> [<Dword count>]",
		cmd_read, 2, 2),
	SHELL_CMD_ARG(readid, &dsub_device_name,
		"[<device>] <address> [<Dword count>]",
		cmd_read_id, 2, 2),
	SHELL_CMD_ARG(readsf, &dsub_device_name,
		"[<device>] <address> [<Dword count>]",
		cmd_read_sfdp, 2, 2),
	SHELL_CMD_ARG(test, &dsub_device_name,
		"[<device>] <address> <size> <repeat count>",
		cmd_test, 4, 1),
	SHELL_CMD_ARG(write, &dsub_device_name,
		"[<device>] <address> <dword> [<dword>...]",
		cmd_write, 3, BUF_ARRAY_CNT),
	SHELL_SUBCMD_SET_END
);

/**
 * @brief Root flash shell command handler
 */
static int cmd_flash(const struct shell *shell, size_t argc, char **argv)
{
	shell_error(shell, "%s:unknown parameter: %s", argv[0], argv[1]);
	return -EINVAL;
}

SHELL_CMD_ARG_REGISTER(flash, &flash_cmds, "Flash shell commands",
		       cmd_flash, 2, 0);
```

## src/gpio_shell.c
```c
/*****************************************************************************
 * Copyright (C) 2023 Advanced Micro Devices, Inc. All rights reserved.
 ******************************************************************************
 */

#include <zephyr/sys/printk.h>
#include <zephyr/shell/shell.h>
#include <zephyr/init.h>
#include <string.h>
#include <stdio.h>
#include <zephyr/drivers/gpio.h>
#include <stdlib.h>
#include <ctype.h>
#include <zephyr/logging/log.h>

#define LOG_LEVEL CONFIG_LOG_DEFAULT_LEVEL

LOG_MODULE_REGISTER(gpio_shell);

struct args_index {
	uint8_t port;
	uint8_t index;
	uint8_t mode;
	uint8_t value;
};

static const struct args_index args_indx = {
	.port = 1,
	.index = 2,
	.mode = 3,
	.value = 3,
};

/**
 * @brief Shell command handler to configure a GPIO pin
 *
 * @param sh Pointer to shell instance
 * @param argc Argument count
 * @param argv Argument vector
 * @return 0 on success, negative error code on failure
 */
static int cmd_gpio_conf(const struct shell *sh, size_t argc, char **argv)
{
	uint8_t index = 0U;
	int type = GPIO_OUTPUT;
	const struct device *dev;

	if (isdigit((unsigned char)argv[args_indx.index][0]) &&
	    isalpha((unsigned char)argv[args_indx.mode][0])) {
		index = (uint8_t)atoi(argv[args_indx.index]);
		if (!strcmp(argv[args_indx.mode], "in")) {
			type = GPIO_INPUT;
		} else if (!strcmp(argv[args_indx.mode], "inu")) {
			type = GPIO_INPUT | GPIO_PULL_UP;
		} else if (!strcmp(argv[args_indx.mode], "ind")) {
			type = GPIO_INPUT | GPIO_PULL_DOWN;
		} else if (!strcmp(argv[args_indx.mode], "out")) {
			type = GPIO_OUTPUT;
		} else {
			return 0;
		}
	} else {
		shell_error(sh, "Wrong parameters for conf");
		return -ENOTSUP;
	}

	dev = device_get_binding(argv[args_indx.port]);

	if (dev != NULL) {
		index = (uint8_t)atoi(argv[args_indx.index]);
		shell_print(sh, "Configuring %s pin %d",
			    argv[args_indx.port], index);
		gpio_pin_configure(dev, index, type);
	}

	return 0;
}

/**
 * @brief Shell command handler to get a GPIO pin value
 *
 * @param sh Pointer to shell instance
 * @param argc Argument count
 * @param argv Argument vector
 * @return 0 on success, negative error code on failure
 */
static int cmd_gpio_get(const struct shell *sh,
			size_t argc, char **argv)
{
	const struct device *dev;
	uint8_t index = 0U;
	int rc;

	if (isdigit((unsigned char)argv[args_indx.index][0])) {
		index = (uint8_t)atoi(argv[args_indx.index]);
	} else {
		shell_error(sh, "Wrong parameters for get");
		return -EINVAL;
	}

	dev = device_get_binding(argv[args_indx.port]);

	if (dev != NULL) {
		index = (uint8_t)atoi(argv[2]);
		shell_print(sh, "Reading %s pin %d",
			    argv[args_indx.port], index);
		rc = gpio_pin_get(dev, index);
		if (rc >= 0) {
			shell_print(sh, "Value %d", rc);
		} else {
			shell_error(sh, "Error %d reading value", rc);
			return -EIO;
		}
	}

	return 0;
}

/**
 * @brief Shell command handler to set a GPIO pin value
 *
 * @param sh Pointer to shell instance
 * @param argc Argument count
 * @param argv Argument vector
 * @return 0 on success, negative error code on failure
 */
static int cmd_gpio_set(const struct shell *sh,
			size_t argc, char **argv)
{
	const struct device *dev;
	uint8_t index = 0U;
	uint8_t value = 0U;

	if (isdigit((unsigned char)argv[args_indx.index][0]) &&
	    isdigit((unsigned char)argv[args_indx.value][0])) {
		index = (uint8_t)atoi(argv[args_indx.index]);
		value = (uint8_t)atoi(argv[args_indx.value]);
	} else {
		shell_print(sh, "Wrong parameters for set");
		return -EINVAL;
	}
	dev = device_get_binding(argv[args_indx.port]);

	if (dev != NULL) {
		index = (uint8_t)atoi(argv[2]);
		shell_print(sh, "Writing to %s pin %d",
			    argv[args_indx.port], index);
		gpio_pin_set(dev, index, value);
	}

	return 0;
}


/* 500 msec = 1/2 sec */
#define SLEEP_TIME_MS   500

/**
 * @brief Shell command handler to blink a GPIO pin
 *
 * @param sh Pointer to shell instance
 * @param argc Argument count
 * @param argv Argument vector
 * @return 0 on success, negative error code on failure
 */
static int cmd_gpio_blink(const struct shell *sh,
			  size_t argc, char **argv)
{
	const struct device *dev;
	uint8_t index = 0U;
	uint8_t value = 0U;
	size_t count = 0;
	char data;

	if (isdigit((unsigned char)argv[args_indx.index][0])) {
		index = (uint8_t)atoi(argv[args_indx.index]);
	} else {
		shell_error(sh, "Wrong parameters for blink");
		return -EINVAL;
	}
	dev = device_get_binding(argv[args_indx.port]);

	if (dev != NULL) {
		index = (uint8_t)atoi(argv[2]);
		shell_fprintf(sh, SHELL_NORMAL, "Blinking port %s index %d.", argv[1], index);
		shell_fprintf(sh, SHELL_NORMAL, " Hit any key to exit");

		while (true) {
			(void)sh->iface->api->read(sh->iface, &data, sizeof(data), &count);
			if (count != 0) {
				break;
			}
			gpio_pin_set(dev, index, value);
			value = !value;
			k_msleep(SLEEP_TIME_MS);
		}

		shell_fprintf(sh, SHELL_NORMAL, "\n");
	}

	return 0;
}

SHELL_STATIC_SUBCMD_SET_CREATE(sub_gpio,
			       SHELL_CMD_ARG(conf, NULL, "Configure GPIO", cmd_gpio_conf, 4, 0),
			       SHELL_CMD_ARG(get, NULL, "Get GPIO value", cmd_gpio_get, 3, 0),
			       SHELL_CMD_ARG(set, NULL, "Set GPIO", cmd_gpio_set, 4, 0),
			       SHELL_CMD_ARG(blink, NULL, "Blink GPIO", cmd_gpio_blink, 3, 0),
			       SHELL_SUBCMD_SET_END /* Array terminated. */
			       );

SHELL_CMD_REGISTER(gpio, &sub_gpio, "GPIO commands", NULL);
```

## src/memory_service.c
```c
/*****************************************************************************
 * Copyright (C) 2023 Advanced Micro Devices, Inc. All rights reserved.
 ******************************************************************************
 */

#include <zephyr/kernel.h>
#include <zephyr/device.h>
#include <zephyr/shell/shell.h>
#include <zephyr/drivers/flash.h>
#include <stdlib.h>

#define EXT_FLASH           DT_NODELABEL(ext_flash0)
static const struct device *extflash_dev;
struct args_index {
	uint8_t device;
	uint8_t offset;
	uint8_t length;
	uint8_t data;
	uint8_t pattern;
	uint8_t type;
};

static const struct args_index args_indx = {
	.offset = 1,
	.length = 2,
	.data = 2,
	.pattern = 3,
	.type = 4,
};

/**
 * @brief Shell command handler to read memory at specified address
 *
 * @param shell Pointer to shell instance
 * @param argc Argument count
 * @param argv Argument vector containing address and length
 * @return 0 on success
 */
static int cmd_read(const struct shell *shell, size_t argc, char **argv)
{
	size_t addr;
	size_t len;
	size_t pending;
	size_t upto;

	addr = strtoul(argv[args_indx.offset], NULL, 0);
	len = strtoul(argv[args_indx.length], NULL, 0);


	shell_print(shell, "Reading %d bytes from memory, addr %x...", len,
		    addr);

	for (upto = 0; upto < len; upto += pending) {
		uint8_t data[SHELL_HEXDUMP_BYTES_IN_LINE];

		pending = MIN(len - upto, SHELL_HEXDUMP_BYTES_IN_LINE);
		for (int i=0;i<pending;i++) {
                    data[i] = *(uint8_t  *)(addr+i);
                }

		shell_hexdump_line(shell, addr, data, pending);
		addr += pending;
	}

	shell_print(shell, "");
	return 0;
}

/**
 * @brief Shell command handler to read external flash at specified address
 *
 * @param shell Pointer to shell instance
 * @param argc Argument count
 * @param argv Argument vector containing address and length
 * @return 0 on success
 */
static int cmd_read_flash(const struct shell *shell, size_t argc, char **argv)
{
	size_t addr;
	size_t len;
	size_t pending;
	size_t upto;

	addr = strtoul(argv[args_indx.offset], NULL, 0);
	len = strtoul(argv[args_indx.length], NULL, 0);


	shell_print(shell, "Reading %d bytes from memory, addr %x...", len,
		    addr);
	extflash_dev =  DEVICE_DT_GET(EXT_FLASH);
	

	for (upto = 0; upto < len; upto += pending) {
		uint8_t data[SHELL_HEXDUMP_BYTES_IN_LINE];

		pending = MIN(len - upto, SHELL_HEXDUMP_BYTES_IN_LINE);

		flash_read(extflash_dev,addr,data,pending);
		shell_hexdump_line(shell, addr, data, pending);
		addr += pending;
	}

	shell_print(shell, "");
	return 0;
}

/**
 * @brief Check if memory address range is accessible
 *
 * @param addr Starting address to check
 * @param length Length of memory range
 * @return 1 if access is permitted, 0 otherwise
 */
unsigned char  Mem_AccessOK(unsigned int addr, unsigned int  length)
{
    
    return 1;
}

/**
 * @brief Shell command handler to write data to memory
 *
 * @param shell Pointer to shell instance
 * @param argc Argument count
 * @param argv Argument vector containing address, value, length, and optional type
 * @return 0 on success, -1 on argument error
 */
static int cmd_write(const struct shell *shell, size_t argc,char** argv)
{
  int i;
  unsigned int   w_addr, w_value,w_length;
  unsigned int   *mem_ptr32;
  unsigned short   *mem_ptr16;
  unsigned char    *mem_ptr8;
  char mode;

  if (argc < 4 || argc > 5)
  {
    shell_print(shell,"Error argument! Help with 'H/h w'");
    return -1;
  }
  /* translate the string into number */
  w_addr = strtoul(argv[args_indx.offset], NULL, 0);
  w_length = strtoul(argv[args_indx.pattern], NULL, 0);
  w_value = strtoul(argv[args_indx.data], NULL, 0);
 
  if (argc ==4) 
  {
     mode = 'W';
  } 
  else 
  {
     mode = argv[args_indx.type][0];
  }

  switch(mode)
  {
      case 'W':
        if(Mem_AccessOK(w_addr, 0))
        {
          
            mem_ptr32 = (unsigned int *)( w_addr & 0xfffffffc) ;
            for (i = 0; i < w_length; i++)
            {
              *mem_ptr32 = w_value;
              mem_ptr32++;
            }
         
          shell_print(shell,"SUCCESS for write memory!");
        }
        else
        {
          shell_print(shell,"Error address for write! Help 'H/h w'");
        }
        break;

    case 'H':
      if(Mem_AccessOK (w_addr, 0))
      {

          mem_ptr16 = (unsigned short *)( w_addr & 0xfffffffe) ;
          for (i = 0; i < w_length; i++)
          {
            *mem_ptr16 = w_value;
            mem_ptr16++;
          }
        shell_print(shell,"SUCCESS for write memory!");
      }
      else
      {
        shell_print(shell,"Error address for write! Help 'H/h w'");
      }
      break;
    case 'B':
      if(Mem_AccessOK (w_addr, 0))
      {
        
          mem_ptr8 = (unsigned char *) w_addr  ;
          for (i = 0; i < w_length; i++)
          {
            *mem_ptr8 = w_value;
            mem_ptr8++;
          }
        shell_print(shell,"SUCCESS for write memory!");
      }
      else
      {
        shell_print(shell,"Error address for write! Help 'H/h w'");
      }
      break;

    default:
      shell_print(shell,"Error argument!");

      return 0;
    }
    return 0;
}


SHELL_STATIC_SUBCMD_SET_CREATE(memory_cmds,
	SHELL_CMD_ARG(read, NULL, "<addr> <length>", cmd_read, 3, 0),
	SHELL_CMD_ARG(readflash, NULL, "<addr> <length>", cmd_read_flash, 3, 0),
	SHELL_CMD_ARG(write, NULL,
		      "<addr> [byte0] <byte1> .. <byteN>", cmd_write,
		      3, 10),
	SHELL_SUBCMD_SET_END
);

SHELL_CMD_REGISTER(memory, &memory_cmds, "Memory shell commands", NULL);
```
